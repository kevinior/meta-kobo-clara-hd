## conf/layer.conf
```bitbake
# We have a conf and classes directory, add to BBPATH
BBPATH .= ":${LAYERDIR}"

# We have recipes-* directories, add to BBFILES
BBFILES += "${LAYERDIR}/recipes-*/*/*.bb \
            ${LAYERDIR}/recipes-*/*/*.bbappend"

BBFILE_COLLECTIONS += "meta-kobo-clara-hd"
BBFILE_PATTERN_meta-kobo-clara-hd = "^${LAYERDIR}/"
BBFILE_PRIORITY_meta-kobo-clara-hd = "91"

BBFILES_DYNAMIC += " \
    meta-freescale:${LAYERDIR}/dynamic-layers/meta-freescale/*/*/*.bbappend \
    meta-imx-bsp:${LAYERDIR}/dynamic-layers/meta-freescale/*/*/*.bbappend \
    fsl-bsp-release:${LAYERDIR}/dynamic-layers/meta-freescale/*/*/*.bbappend \
"

LAYERDEPENDS_meta-kobo-clara-hd = "core"
LAYERSERIES_COMPAT_meta-kobo-clara-hd = "wrynose"

MACHINE_FEATURES:remove = "nxp8987"
MACHINE_EXTRA_RRECOMMENDS:remove = "linux-firmware-nxp89xx nxp-wlan-sdk kernel-module-nxp89xx"
MACHINE_FIRMWARE:remove = "linux-firmware-nxp89xx"
```

## conf/machine/kobo-clara-hd.conf
```bitbake
#@TYPE: Machine
#@NAME: Kobo Clara HD
#@SOC: i.MX6SLL
#@DESCRIPTION: Machine configuration for Kobo Clara HD
#@MAINTAINER: Kevin O'Rourke misc1-claradev@caboose.org.uk

# Based on NXP imx6sllevk

MACHINEOVERRIDES =. "mx6:mx6sll:"

include conf/machine/include/imx-base.inc
include conf/machine/include/arm/armv7a/tune-cortexa9.inc

KERNEL_DEVICETREE_BASENAME = "imx6sll-kobo-clarahd"
KERNEL_DEVICETREE = "nxp/imx/${KERNEL_DEVICETREE_BASENAME}.dtb"

UBOOT_CONFIG ??= "sd"
UBOOT_CONFIG[sd] = "mx6sllclarahd_defconfig,sdcard"
UBOOT_BINARY = "u-boot-dtb.imx"
UBOOT_EXTLINUX = "1"
UBOOT_EXTLINUX_LABELS = "default"
UBOOT_EXTLINUX_FDT = "../${KERNEL_DEVICETREE_BASENAME}.dtb"
UBOOT_EXTLINUX_CONSOLE = "console=${console}"
UBOOT_EXTLINUX_ROOT = "root=/dev/mmcblk0p1"
#UBOOT_CONFIG[sd] = "mx6sll_ntx_lpddr2_512m_config,sdcard"

SERIAL_CONSOLES = "115200;ttymxc0"

MACHINE_FEATURES:append = " wifi"
MACHINE_FEATURES:remove = " alsa"
MACHINE_EXTRA_RRECOMMENDS:remove = "imx-alsa-plugins"

XSERVER = "xserver-xorg \
           xf86-input-evdev \
           xf86-video-modesetting \
        "
# MESA DRI library
#XSERVER += "mesa-driver-swrast"

# Choose a bootloader
PREFERRED_PROVIDER_u-boot = "u-boot-kobo"
PREFERRED_PROVIDER_virtual/bootloader = "u-boot-kobo"
#PREFERRED_PROVIDER_u-boot = "u-boot-imx"
#PREFERRED_PROVIDER_virtual/bootloader = "u-boot-imx"
PREFERRED_PROVIDER_u-boot-fw-utils = "u-boot-kobo-fw-utils"
PREFERRED_RPROVIDER_u-boot-fw-utils = "u-boot-kobo-fw-utils"

# Choose the kernel recipe
PREFERRED_PROVIDER_virtual/kernel = "linux-yocto-akemnade"

# Override broken IMAGE_BOOT_FILES
IMAGE_BOOT_FILES = " \
    ${KERNEL_IMAGETYPE} \
    ${KERNEL_DEVICETREE} \
    extlinux.conf;boot/extlinux/extlinux.conf \
"

WKS_FILE = "imx-uboot-clara.wks.in"

# Add the out-of-tree rtl8189fs wifi module.
MACHINE_EXTRA_RRECOMMENDS += "kernel-module-8189fs"

# Make sure we have the device tree in /boot
MACHINE_ESSENTIAL_EXTRA_RDEPENDS += " \
    kernel-image \
    kernel-devicetree \
"

IMAGE_FSTYPES:append = " ext4"
```
